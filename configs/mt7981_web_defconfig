## configs/mt7981_web_defconfig
```kconfig
CONFIG_ARM=y
CONFIG_ARCH_MEDIATEK=y
CONFIG_TARGET_MT7981=y
CONFIG_DEFAULT_DEVICE_TREE="mt7981"
CONFIG_NET=y
CONFIG_CMD_NET=y
CONFIG_CMD_PING=y
CONFIG_CMD_DHCP=y
CONFIG_CMD_TFTPBOOT=y
CONFIG_CMD_HTTPD=y   # ✅ 开启 Web 恢复功能
CONFIG_CMD_USB=y
CONFIG_CMD_USB_MASS_STORAGE=y
CONFIG_ENV_IS_IN_MMC=n
CONFIG_ENV_IS_IN_SPI_FLASH=y
CONFIG_ENV_OFFSET=0x80000
CONFIG_ENV_SIZE=0x20000
```
